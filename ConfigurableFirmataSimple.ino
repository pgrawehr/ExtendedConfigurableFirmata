/*
 * CommonFirmataFeatures.ino generated by FirmataBuilder
 * Sun Mar 29 2020 15:10:48 GMT-0400 (EDT)
 */

#include <ConfigurableFirmata.h>

#include <DigitalInputFirmata.h>
DigitalInputFirmata digitalInput;

#include <DigitalOutputFirmata.h>
DigitalOutputFirmata digitalOutput;

#include <AnalogInputFirmata.h>
AnalogInputFirmata analogInput;

#include <AnalogOutputFirmata.h>
AnalogOutputFirmata analogOutput;

#include <Wire.h>
#include <I2CFirmata.h>
I2CFirmata i2c;

//#include <OneWireFirmata.h>
//OneWireFirmata oneWire;

#include <SerialFirmata.h>
SerialFirmata serial;

#include <FirmataExt.h>
FirmataExt firmataExt;

#include <SpiFirmata.h>
SpiFirmata spi;

//#include <Servo.h>
//#include <ServoFirmata.h>
//ServoFirmata servo;

#include <AnalogWrite.h>

// The scheduler allows to store scripts on the board, however this requires a kind of compiler on the client side.
// The feature only needs 20Bytes of Ram, so it doesn't hurt to have it (There's enough flash left)
#include <FirmataScheduler.h>
FirmataScheduler scheduler;

#include <FirmataReporting.h>
FirmataReporting reporting;

// #include <AccelStepperFirmata.h>
// AccelStepperFirmata accelStepper;

// #include <DhtFirmata.h>
// DhtFirmata dhtFirmata;

#include "FirmataIlExecutor.h"
FirmataIlExecutor ilExecutor;

#ifdef DEBUG_STREAM
const byte SimulatedInput[] PROGMEM =
{
    0xFF, 0xF9, 0xF0, 0x79, 0xF7, 0xF0, 0x6B, 0xF7, 0xF0, 0x69, 0xF7, 0xD0, 0x01, 0xD1, 0x01, 0xD2,
	0x01, // Until here goes the initialisation sequence of the test application
    0xF0, 0x7B, 0xFF, 0x02, 0x00, 0x0C, 0x00, 0x02, 0x25, 0x01, 0x00, 0x00, 0x00, 0x00, 0x06,
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0x00, 0x00, 0x00, 0x00, 0x00, 0xF7,
};

#include <FlashMemoryStream.h>
FlashMemoryStream debugStream(SimulatedInput, sizeof(SimulatedInput));
#endif

void systemResetCallback()
{
  for (byte i = 0; i < TOTAL_PINS; i++) {
    if (IS_PIN_ANALOG(i)) {
      Firmata.setPinMode(i, ANALOG);
    } else if (IS_PIN_DIGITAL(i)) {
      Firmata.setPinMode(i, OUTPUT);
    }
  }
  firmataExt.reset();
}

void initTransport()
{
  // Uncomment to save a couple of seconds by disabling the startup blink sequence.
  // Firmata.disableBlinkVersion();
#ifdef DEBUG_STREAM
    Firmata.begin(debugStream);
#else
    Firmata.begin(115200);
#endif
}

void initFirmata()
{
  Firmata.setFirmwareVersion(FIRMATA_FIRMWARE_MAJOR_VERSION, FIRMATA_FIRMWARE_MINOR_VERSION);

  firmataExt.addFeature(digitalInput);
  firmataExt.addFeature(digitalOutput);
  firmataExt.addFeature(analogInput);
  firmataExt.addFeature(analogOutput);
  // firmataExt.addFeature(servo);
  firmataExt.addFeature(i2c);
  // firmataExt.addFeature(oneWire);
  firmataExt.addFeature(serial);
  firmataExt.addFeature(scheduler);
  firmataExt.addFeature(reporting);
  firmataExt.addFeature(spi);
  // firmataExt.addFeature(accelStepper);
  // firmataExt.addFeature(dhtFirmata);
  firmataExt.addFeature(ilExecutor);

  Firmata.attach(SYSTEM_RESET, systemResetCallback);
}

void setup()
{
  initFirmata();

  initTransport();

  Firmata.parse(SYSTEM_RESET);
}

void loop()
{
  digitalInput.report();

  while(Firmata.available()) {
    Firmata.processInput();
    if (!Firmata.isParsingMessage()) {
      goto runtasks;
    }
  }
  if (!Firmata.isParsingMessage()) {
runtasks: scheduler.runTasks();
  }
  
  if (reporting.elapsed()) {
    analogInput.report();
    i2c.report();
  }

  // accelStepper.update();
  serial.update();
}
